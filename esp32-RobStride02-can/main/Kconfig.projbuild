## esp32-RobStride02-can/main/Kconfig.projbuild
```kconfig
menu "RobStride RS02 CAN example"

    config RS02_MOTOR_ID
        int "RobStride RS02 motor CAN ID"
        range 0 255
        default 127
        help
            Target RobStride RS02 motor CAN ID. A factory-default motor normally uses 127 (0x7F).

    config RS02_HOST_ID
        int "ESP32 host CAN ID"
        range 0 255
        default 253
        help
            Host CAN ID placed in enable, stop, and feedback frames. The example default is 253 (0xFD).

    config RS02_TWAI_TX_GPIO
        int "TWAI TX GPIO"
        range 0 48
        default 4

    config RS02_TWAI_RX_GPIO
        int "TWAI RX GPIO"
        range 0 48
        default 5

    config RS02_RUN_LINK_SOAK_TEST
        bool "Run a 60-second zero-effort CAN link soak test"
        default n
        help
            Diagnostic mode for intermittent CAN receive errors. It keeps the measured initial
            position as the target and sends 50 Hz control frames for 60 seconds with desired
            velocity, feed-forward torque, Kp, and Kd all zero. Existing feedback, tracking,
            temperature, and fatal TWAI checks remain active. This mode does not command motion,
            but the motor is enabled during the test and software checks do not replace a physical
            power cutoff. Keep the motion test disabled while collecting a link-soak log.

    config RS02_RUN_MOTION_TEST
        bool "Explicitly run one 60-degree out-and-back motion test"
        depends on !RS02_RUN_LINK_SOAK_TEST
        default n
        help
            WARNING: this option commands physical movement. Secure and unload the RS02,
            clear at least 60 degrees in either direction, use a current-limited supply, and
            keep a physical power cutoff within reach. After the 500 ms zero-effort check,
            the target follows a smooth 60-degree trajectory over 3 seconds, settles for
            700 ms, returns over 3 seconds, settles again, and stops. Kp is 12.0, Kd is 1.0,
            and feed-forward torque is zero. Provisional software guards reject absolute
            speed at 0.8 rad/s, feedback torque at 1.5 N m, estimated controller effort at
            1.0 N m, tracking error at 0.075 rad, or endpoint error at 0.035 rad. These are
            software observations and estimates, not certified or hardware safety limits.

    config RS02_RUN_WEB_CONSOLE
        bool "Run the Wi-Fi bench-test web console"
        depends on !RS02_RUN_LINK_SOAK_TEST && !RS02_RUN_MOTION_TEST
        default n
        help
            Start a WPA2 SoftAP and self-hosted control page at 192.168.4.1. The page can
            prepare an absolute 0-360 degree load-side target referenced to the encoder
            origin, travel time, a 0.3-33.0 rad/s software speed guard, and a 0.1-14.0 N m
            temporary motor torque limit. A no-motion preflight reads mechPos and computes
            only the signed difference from the current single-turn angle to the requested
            target. Server-side validation keeps the RS02 position-command span and adds
            0.25 rad/s between theoretical smoothstep peak speed and the derived software
            speed guard. Slider changes run preflight automatically, but motion still requires a
            separate confirmation click within 30 seconds. Reset and page refresh do not
            command motion. The web profile stops at its target instead of returning.

    config RS02_WEB_AP_PASSWORD
        string "Web-console WPA2 password"
        depends on RS02_RUN_WEB_CONSOLE
        default "rs02-bench"
        help
            WPA2 password for the RS02-BENCH-xxxx SoftAP. It must contain 8 to 63 characters.
            An explicit confirmation click is still required; Wi-Fi authentication is not a safety control.

endmenu
```

## esp32-RobStride02-can/sdkconfig.defaults
```kconfig
CONFIG_ESPTOOLPY_FLASHSIZE_16MB=y
CONFIG_ESPTOOLPY_FLASHSIZE="16MB"
CONFIG_RS02_MOTOR_ID=127
CONFIG_RS02_HOST_ID=253
CONFIG_RS02_TWAI_TX_GPIO=4
CONFIG_RS02_TWAI_RX_GPIO=5
# CONFIG_RS02_RUN_LINK_SOAK_TEST is not set
# CONFIG_RS02_RUN_MOTION_TEST is not set
# CONFIG_RS02_RUN_WEB_CONSOLE is not set
```

## esp32-cybergear-can/main/Kconfig.projbuild
```kconfig
menu "CyberGear CAN example"

    config CYBERGEAR_MOTOR_ID
        int "CyberGear motor CAN ID"
        range 0 255
        default 127
        help
            Target CyberGear motor CAN ID. A factory-default motor normally uses 127 (0x7F).

    config CYBERGEAR_HOST_ID
        int "ESP32 host CAN ID"
        range 0 255
        default 253
        help
            Host CAN ID placed in enable, stop, and feedback frames. The example default is 253 (0xFD).

    config CYBERGEAR_TWAI_TX_GPIO
        int "TWAI TX GPIO"
        range 0 48
        default 4

    config CYBERGEAR_TWAI_RX_GPIO
        int "TWAI RX GPIO"
        range 0 48
        default 5

    config CYBERGEAR_RUN_LINK_SOAK_TEST
        bool "Run a 60-second zero-effort CAN link soak test"
        default n
        help
            Diagnostic mode for intermittent CAN receive errors. It keeps the measured initial
            position as the target and sends 50 Hz control frames for 60 seconds with desired
            velocity, feed-forward torque, Kp, and Kd all zero. Existing feedback, tracking,
            temperature, and fatal TWAI checks remain active. This mode does not command motion,
            but the motor is enabled during the test and software checks do not replace a physical
            power cutoff. Keep the explicit motion test disabled while collecting a link-soak log.

    config CYBERGEAR_RUN_MOTION_TEST
        bool "Explicitly allow the 360-degree out-and-back test (10 seconds per leg)"
        default n
        help
            WARNING: enabling this option permits physical motor movement. Secure and unload the motor,
            use a current-limited 24 V supply, verify CAN termination, and keep an emergency power cutoff
            within reach. The default build performs communication and zero-effort validation only.
            After 500 ms of zero effort, capture the measured origin, ramp +2pi rad over 10 seconds
            (negative near the positive protocol limit), return over 10 seconds, then stop once.
            Clear the full-turn sweep, prevent cable winding, and supervise the approximately 20-second test.
            Absolute speed must stay below 0.5 rad/s during zero effort and 1.0 rad/s during motion;
            absolute position error relative to the current target must stay below 0.10 rad.
            Abort if position differs from the current trajectory target by 0.10 rad or more.
            Desired velocity follows the signed trajectory slope (+/-0.628 rad/s); feed-forward
            torque remains zero. Kp=90.0 and Kd=1.0 increase effort only when tracking error or
            velocity error appears; they are not hard actual speed or torque limits. Strict
            feedback-torque trips are 1.0 N m during zero effort and 10.0 N m during Motion;
            before each transmission, the combined feed-forward, position-error, and velocity-error
            controller estimate must also remain strictly below the phase's torque threshold.
            These are software checks, not motor current/torque limiters. All thresholds are provisional.

endmenu
```

## esp32-cybergear-can/sdkconfig.defaults
```kconfig
CONFIG_ESPTOOLPY_FLASHSIZE_16MB=y
CONFIG_ESPTOOLPY_FLASHSIZE="16MB"
CONFIG_CYBERGEAR_MOTOR_ID=127
CONFIG_CYBERGEAR_HOST_ID=253
CONFIG_CYBERGEAR_TWAI_TX_GPIO=4
CONFIG_CYBERGEAR_TWAI_RX_GPIO=5
# CONFIG_CYBERGEAR_RUN_MOTION_TEST is not set
```
